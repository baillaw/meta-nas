## conf/distro/poky-nas.conf
```bitbake
# Distribution definition for: poky-nas
#
# Copyright (c) 2015 Baptiste DURAND
# All rights reserved.
#
# This file is released under the MIT license as described in
# ../../LICENSE.
#


require conf/distro/poky.conf
DISTRO = "poky-nas"


DOWNLOAD_DIR_TRANSMISSION ?= "/Downloads/"
USER_FOR_AUTH ?= "meta-nas"
PASS_FOR_AUTH ?= "meta-nas"
UID_FOR_AUTH ?= "2000"

DISTRO_FEATURES += " busybox_send_email "
```

## conf/layer.conf
```bitbake
# We have a conf and classes directory, append to BBPATH
BBPATH .= ":${LAYERDIR}"

# We have a recipes directory, add to BBFILES
BBFILES += "${LAYERDIR}/recipes-*/*/*.bb ${LAYERDIR}/recipes-*/*/*.bbappend"
BBFILES += "${LAYERDIR}/images/*.bb"
BBFILE_COLLECTIONS += "nas-layer"
BBFILE_PATTERN_nas-layer := "^${LAYERDIR}/"
BBFILE_PRIORITY_nas-layer = "6"
LAYERSERIES_COMPAT_nas-layer = "sumo zeus"
LAYERDEPENDS_nas-layer = "core"
LAYERDEPENDS_nas-layer += "openembedded-layer"

DISTRO_FEATURES_append = " libc-posix-wchar-io libc-locale-code "
DISTRO ?= "poky-nas"
PACKAGECONFIG_append_pn-qemu-native = " libusb "
```
